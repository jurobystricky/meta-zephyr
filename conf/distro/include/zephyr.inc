## conf/distro/include/zephyr.inc
```bitbake
SANITY_TESTED_DISTROS = " \
            Ubuntu-14.04 \n \
            Ubuntu-15.04 \n \
            "

DISTRO = "zephyr"
DISTRO_CODENAME = "zephyr"
DISTRO_NAME = "Zephyr Yocto Toolchain"
MAINTAINER = "Intel Yocto team"

SSTATE_DIR ?= "${TOPDIR}/../zephyr-cache/sstate-cache"
CACHE_forcevariable = "${TOPDIR}/../zephyr-cache/cache"
PERSISTENT_DIR = "${TOPDIR}/../zephyr-cache/persistent"
```

## conf/distro/zephyr.conf
```bitbake
require conf/distro/poky.conf
require include/zephyr.inc

DISTRO_VERSION = "0.7"
PACKAGE_CLASSES = "package_ipk"
```

## conf/layer.conf
```bitbake
# We have a conf and classes directory, add to BBPATH
BBPATH := "${BBPATH}:${LAYERDIR}"

# We have a packages directory, add to BBFILES
BBFILES += "${LAYERDIR}/recipes*/*/*.bb ${LAYERDIR}/recipes*/*/*.bbappend"

BBFILE_COLLECTIONS += "zephyr"
BBFILE_PATTERN_zephyr := "^${LAYERDIR}/"
BBFILE_PRIORITY_zephyr = "8"
```
